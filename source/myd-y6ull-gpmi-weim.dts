/*
 * Copyright (C) 2016 Freescale Semiconductor, Inc.
 * Copyright (C) myir alex 
 * This program is free software; you can redistribute it and/or modify
 * it under the terms of the GNU General Public License version 2 as
 * published by the Free Software Foundation.
 */

#include "myb-imx6ull-14x14-base.dts"

&usdhc1 {
    max-frequency = <50000000>;
    bus-width = <4>;
    no-1-8-v;   /* force 3.3V VIO */
    non-removable;
    pm-ignore-notify;
    cap-power-off-card;
    status = "okay";

};

&usdhc2 {
    status = "disabled";  /* WiFi 禁用，保留 extio0-2 */
};
